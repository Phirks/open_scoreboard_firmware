## build/Kconfig/Kconfig.shield
```kconfig
osource "c:/scoreboard/scoreboard_board/boards/shields/*/Kconfig.shield"
osource "c:/scoreboard/scoreboard_firmware/boards/shields/*/Kconfig.shield"
osource "C:/ncs/v2.6.0/nrf/boards/shields/*/Kconfig.shield"
```

## build/Kconfig/Kconfig.shield.defconfig
```kconfig
osource "c:/scoreboard/scoreboard_board/boards/shields/*/Kconfig.defconfig"
osource "c:/scoreboard/scoreboard_firmware/boards/shields/*/Kconfig.defconfig"
osource "C:/ncs/v2.6.0/nrf/boards/shields/*/Kconfig.defconfig"
```
